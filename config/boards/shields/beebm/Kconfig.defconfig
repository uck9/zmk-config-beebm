## config/boards/shields/beebm/Kconfig.defconfig
```kconfig
if SHIELD_BEEBM_LEFT

config ZMK_KEYBOARD_NAME
    default "BBCMicro"

config ZMK_SPLIT_ROLE_CENTRAL
    default y

endif

if SHIELD_BEEBM_LEFT || SHIELD_BEEBM_RIGHT

config ZMK_SPLIT
    default y

endif
```

## config/boards/shields/beebm/Kconfig.shield
```kconfig
config SHIELD_BEEBM_LEFT
    def_bool $(shields_list_contains,beebm_left)

config SHIELD_BEEBM_RIGHT
    def_bool $(shields_list_contains,beebm_right)
```
