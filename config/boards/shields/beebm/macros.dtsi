mcr_copy: mcr_copy {
    compatible = "zmk,behavior-macro";
    label = "mcr_copy";
    #binding-cells = <0>;
    bindings = 
        <&macro_press &kp LEFT_CTRL>,
        <&macro_tap &kp C>,
        <&macro_release &kp LEFT_CTRL>;
};
mcr_paste: mcr_paste {
    compatible = "zmk,behavior-macro";
    label = "mcr_paste";
    #binding-cells = <0>;
    bindings = 
        <&macro_press &kp LEFT_CTRL>,
        <&macro_tap &kp V>,
        <&macro_release &kp LEFT_CTRL>;
};